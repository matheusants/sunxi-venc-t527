## sunxi-venc/Kconfig
```kconfig
# SPDX-License-Identifier: GPL-2.0
config VIDEO_SUNXI_VENC
	tristate "Allwinner sunxi H264 hardware encoder driver"
	depends on VIDEO_DEV && VIDEO_V4L2
	depends on HAS_DMA
	depends on OF
	select MEDIA_CONTROLLER
	select VIDEOBUF2_DMA_CONTIG
	select V4L2_MEM2MEM_DEV
	help
	  Support for the H264 encode engine of the Allwinner T527 Video
	  Engine. Exposes a stateful V4L2 memory-to-memory encoder: raw NV12
	  frames in, coded H264 bitstream out.

	  To compile this driver as a module, choose M here: the module
	  will be called sunxi-venc.
```
